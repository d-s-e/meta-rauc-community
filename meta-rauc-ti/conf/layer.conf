## meta-rauc-ti/conf/layer.conf
```bitbake
# We have a conf and classes directory, add to BBPATH
BBPATH .= ":${LAYERDIR}"

# We have recipes-* directories, add to BBFILES
BBFILES += "${LAYERDIR}/recipes-*/*/*.bb \
            ${LAYERDIR}/recipes-*/*/*.bbappend"

BBFILE_COLLECTIONS += "meta-rauc-ti"
BBFILE_PATTERN_meta-rauc-ti = "^${LAYERDIR}/"
BBFILE_PRIORITY_meta-rauc-ti = "6"

LAYERDEPENDS_meta-rauc-ti = "core rauc"
LAYERSERIES_COMPAT_meta-rauc-ti = "kirkstone"
```
